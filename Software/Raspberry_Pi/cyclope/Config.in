## Software/Raspberry_Pi/cyclope/Config.in
```kconfig
source "$BR2_EXTERNAL_CYCLOPE_PATH/package/cyclope-controller/Config.in"
source "$BR2_EXTERNAL_CYCLOPE_PATH/package/opencv4/Config.in"
```

## Software/Raspberry_Pi/cyclope/configs/cyclope_defconfig
```kconfig
BR2_arm=y
BR2_cortex_a53=y
BR2_ARM_FPU_NEON_VFPV4=y
BR2_TOOLCHAIN_BUILDROOT_MUSL=y
BR2_PACKAGE_HOST_LINUX_HEADERS_CUSTOM_5_10=y
BR2_TOOLCHAIN_BUILDROOT_CXX=y
BR2_TARGET_GENERIC_HOSTNAME="cyclope"
BR2_TARGET_GENERIC_ROOT_PASSWD="cyclope"
BR2_ROOTFS_OVERLAY="$(BR2_EXTERNAL_CYCLOPE_PATH)/board/cyclope/overlay"
BR2_ROOTFS_POST_BUILD_SCRIPT="$(BR2_EXTERNAL_CYCLOPE_PATH)/board/cyclope/post-build.sh"
BR2_ROOTFS_POST_IMAGE_SCRIPT="$(BR2_EXTERNAL_CYCLOPE_PATH)/board/cyclope/post-image.sh"
BR2_ROOTFS_POST_SCRIPT_ARGS="--add-miniuart-bt-overlay"
BR2_LINUX_KERNEL=y
BR2_LINUX_KERNEL_CUSTOM_TARBALL=y
BR2_LINUX_KERNEL_CUSTOM_TARBALL_LOCATION="$(call github,raspberrypi,linux,abff5012ab7ccbe1227b9d0af69697cc592df44c)/linux-abff5012ab7ccbe1227b9d0af69697cc592df44c.tar.gz"
BR2_LINUX_KERNEL_DEFCONFIG="bcm2709"
BR2_LINUX_KERNEL_DTS_SUPPORT=y
BR2_LINUX_KERNEL_INTREE_DTS_NAME="bcm2710-rpi-3-b bcm2710-rpi-3-b-plus bcm2710-rpi-cm3"
BR2_LINUX_KERNEL_NEEDS_HOST_OPENSSL=y
BR2_PACKAGE_RPI_FIRMWARE=y
BR2_PACKAGE_RPI_FIRMWARE_X=y
BR2_PACKAGE_RPI_WIFI_FIRMWARE=y
BR2_PACKAGE_RPI_USERLAND=y
BR2_PACKAGE_DNSMASQ=y
# BR2_PACKAGE_DNSMASQ_TFTP is not set
BR2_PACKAGE_DROPBEAR=y
# BR2_PACKAGE_DROPBEAR_SMALL is not set
BR2_PACKAGE_HOSTAPD=y
BR2_PACKAGE_HOSTAPD_WPA3=y
BR2_PACKAGE_IW=y
BR2_PACKAGE_SOCAT=y
BR2_PACKAGE_HTOP=y
BR2_TARGET_ROOTFS_EXT2=y
BR2_TARGET_ROOTFS_EXT2_4=y
BR2_TARGET_ROOTFS_EXT2_SIZE="120M"
# BR2_TARGET_ROOTFS_TAR is not set
BR2_PACKAGE_HOST_DOSFSTOOLS=y
BR2_PACKAGE_HOST_GENIMAGE=y
BR2_PACKAGE_HOST_MTOOLS=y
BR2_PACKAGE_CYCLOPE_CONTROLLER=y
```

## Software/Raspberry_Pi/cyclope/package/cyclope-controller/Config.in
```kconfig
config BR2_PACKAGE_CYCLOPE_CONTROLLER
	bool "Cyclope robot controller"
	select BR2_PACKAGE_OPENCV3
	select BR2_PACKAGE_OPENCV3_LIB_IMGCODECS
	select BR2_PACKAGE_OPENCV3_LIB_IMGPROC
	select BR2_PACKAGE_OPENCV3_LIB_VIDEOIO
	select BR2_PACKAGE_OPENCV3_WITH_V4L
	select BR2_PACKAGE_OPENCV3_WITH_JPEG
	select BR2_PACKAGE_LIBV4L
	help
		Handle robot hardware and communicate with PC application.
```
